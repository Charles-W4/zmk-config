## config/boards/shields/thumble/Kconfig.defconfig
```kconfig
# Copyright (c) 2022 The ZMK Contributors
# SPDX-License-Identifier: MIT

if SHIELD_THUMBLE_LEFT

config ZMK_KEYBOARD_NAME
    default "THUMBLE"
    
config ZMK_SPLIT_ROLE_CENTRAL
    default y

endif

if SHIELD_THUMBLE_LEFT || SHIELD_THUMBLE_RIGHT

config ZMK_SPLIT
    default y

endif
```

## config/boards/shields/thumble/Kconfig.shield
```kconfig
# Copyright (c) 2022 The ZMK Contributors
# SPDX-License-Identifier: MIT

config SHIELD_THUMBLE_LEFT
    def_bool $(shields_list_contains,thumble_left)

config SHIELD_THUMBLE_RIGHT
    def_bool $(shields_list_contains,thumble_right)
```

## config/boards/shields/xandar/Kconfig.defconfig
```kconfig
# Copyright (c) 2022 The ZMK Contributors
# SPDX-License-Identifier: MIT

if SHIELD_XANDAR_RIGHT

config ZMK_KEYBOARD_NAME
    default "XANDAR"
    
config ZMK_SPLIT_ROLE_CENTRAL
    default y

endif

if SHIELD_XANDAR_LEFT || SHIELD_XANDAR_RIGHT

config ZMK_SPLIT
    default y

endif
```

## config/boards/shields/xandar/Kconfig.shield
```kconfig
# Copyright (c) 2022 The ZMK Contributors
# SPDX-License-Identifier: MIT

config SHIELD_XANDAR_LEFT
    def_bool $(shields_list_contains,xandar_left)

config SHIELD_XANDAR_RIGHT
    def_bool $(shields_list_contains,xandar_right)
```
